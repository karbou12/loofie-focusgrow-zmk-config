## config/west.yml
```yaml
manifest:
  defaults:
    revision: main
  remotes:
    - name: zmkfirmware
      url-base: https://github.com/zmkfirmware
    - name: MogmaProducts
      url-base: https://github.com/MogmaProducts
    - name: karbou12
      url-base: https://github.com/karbou12
    - name: amgskobo
      url-base: https://github.com/amgskobo
    - name: kot149
      url-base: https://github.com/kot149
  projects:
    - name: zmk
      remote: zmkfirmware
      import: app/west.yml
    - name: loofie-focusgrow-zmk-module
      remote: karbou12
      revision: develop
    - name: zmk-input-inertia
      remote: amgskobo
      revision: main
    - name: zmk-mouse-gesture
      remote: kot149
      revision: v1
    - name: zmk-trackball-shift
      remote: karbou12
      revision: main
  self:
    path: config
```
